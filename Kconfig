## Kconfig
```kconfig
menu "DRV8825 driver"

config STEPPER_DRV_DRV8825
    bool "Enable DRV8825 driver"
    default y
	depends on DT_HAS_TI_DRV8825_ENABLED
	select STEP_DIR_STEPPER
    help
      Enable support for the DRV8825 Stepper Motor Driver.

config STEPPER_DRV_DRV8825_LOG_LEVEL
    int "Log level (0=off..4=debug)"
    range 0 4
    default 3
    depends on STEPPER_DRV_DRV8825

endmenu
```

## Kconfig.defconfig
```kconfig
if DRV8825

config LOG
    default y

config DRV8825_LOG_LEVEL
    default 3

endif
```

## drivers/drv8825/Kconfig
```kconfig
menu "DRV8825 driver"

config DRV8825
    bool "Enable DRV8825 driver"
	depends on DT_HAS_TI_DRV8825_ENABLED
	select STEP_DIR_STEPPER
    help
      Enable support for the DRV8825 Stepper Motor Driver.

config DRV8825_LOG_LEVEL
    int "Log level (0=off..4=debug)"
    range 0 4
    default 3
    depends on DRV8825

endmenu
```

## dts/bindings/stepper/ti,drv8825.yaml
```yaml
# SPDX-License-Identifier: Apache-2.0

title: Texas Instruments DRV8825 Stepper Motor Driver

description: |
  The Texas Instruments DRV8825 is a PWM Microstepping Stepper Motor Driver solution.
  This Binding describes the device when it is connected to the GPIO.

compatible: "ti,drv8825"

include:
  - name: stepper-driver.yaml
  - name: step-dir-timing.yaml

properties:
  step-width-ns:
    default: 970

  fault-gpios:
    type: phandle-array
    description: Fault pin.

  sleep-gpios:
    type: phandle-array
    description: Sleep pin (active low).
  
  reset-gpios:
    type: phandle-array
    description: Reset pin (active low).
  
  m2-gpios:
    type: phandle-array
    description: Microstepping mode pin M2.

examples:
  - |
    drv8825: drv8825 {
      status = "okay";
      compatible = "ti,drv8825";

      fault-gpios = <&arduino_header 16 0>;
      sleep-gpios = <&arduino_header 15 GPIO_ACTIVE_LOW>;
      reset-gpios = <&arduino_header 17 GPIO_ACTIVE_LOW>;
      en-gpios  = <&arduino_header 14 0>;
      m0-gpios = <&mikroe_stepper_gpios 0 0>;
      m1-gpios = <&mikroe_stepper_gpios 1 0>;
      m2-gpios = <&mikroe_stepper_gpios 2 0>;
    };
```
